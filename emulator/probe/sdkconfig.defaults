## emulator/probe/sdkconfig.defaults
```kconfig
CONFIG_IDF_TARGET="esp32s3"
CONFIG_ESPTOOLPY_FLASHSIZE_8MB=y
CONFIG_SPIRAM=y
CONFIG_SPIRAM_USE_MALLOC=y
```

## native_firmware/main/Kconfig.projbuild
```kconfig
menu "Supercon Billboard Badge"

config BADGE_EMULATOR
    bool "Build for QEMU"
    default n
    help
        Disable physical badge I/O and use a small console-backed display path.

endmenu
```
